## src/arch/xtensa/configs/jasperlake_defconfig
```kconfig
CONFIG_ICELAKE=y
CONFIG_RIMAGE_SIGNING_SCHEMA="jsl"
CONFIG_INTEL_DMIC=y
CONFIG_INTEL_SSP=y
CONFIG_INTEL_ALH=y
CONFIG_CORE_COUNT=2
CONFIG_LP_MEMORY_BANKS=1
CONFIG_HP_MEMORY_BANKS=16
CONFIG_COMP_CODEC_ADAPTER=y
CONFIG_WAVES_CODEC=y
CONFIG_COMP_SRC=n
CONFIG_COMP_FIR=n
CONFIG_COMP_IIR=n
CONFIG_COMP_TONE=n
CONFIG_COMP_MIXER=n
CONFIG_COMP_MUX=n
CONFIG_COMP_SWITCH=n
CONFIG_COMP_DCBLOCK=n
CONFIG_COMP_ASRC=n
CONFIG_COMP_TDFB=n
CONFIG_FORMAT_FLOAT=n
```
